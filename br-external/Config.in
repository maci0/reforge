## br-external/package/Config.in
```kconfig
source "$BR2_EXTERNAL_REFORGE_PATH/package/klipper/Config.in"
source "$BR2_EXTERNAL_REFORGE_PATH/package/moonraker/Config.in"
source "$BR2_EXTERNAL_REFORGE_PATH/package/python-inotify-simple/Config.in"
source "$BR2_EXTERNAL_REFORGE_PATH/package/python-libnacl/Config.in"
source "$BR2_EXTERNAL_REFORGE_PATH/package/python-streaming-form-data/Config.in"
source "$BR2_EXTERNAL_REFORGE_PATH/package/python-smart-open/Config.in"
source "$BR2_EXTERNAL_REFORGE_PATH/package/python-importlib-metadata/Config.in"
source "$BR2_EXTERNAL_REFORGE_PATH/package/python-zipp/Config.in"
source "$BR2_EXTERNAL_REFORGE_PATH/package/python-preprocess-cancellation/Config.in"
source "$BR2_EXTERNAL_REFORGE_PATH/package/mainsail/Config.in"
source "$BR2_EXTERNAL_REFORGE_PATH/package/guppyscreen/Config.in"
```

## br-external/package/dinit/Config.in
```kconfig
config BR2_PACKAGE_DINIT
	bool "dinit"
	depends on BR2_USE_MMU
	depends on BR2_INSTALL_LIBSTDCPP
	help
	  dinit is a service supervisor and init system (capable of
	  running as PID 1) with dependency management and process
	  supervision. Small, C++, no systemd.

	  Packaged for ReForge as a building block for a future
	  switch_root init. The package ships the dinit binaries only —
	  no service definitions and no init wiring yet.

	  https://davmac.org/projects/dinit/

comment "dinit needs a toolchain w/ C++"
	depends on BR2_USE_MMU
	depends on !BR2_INSTALL_LIBSTDCPP
```

## br-external/package/guppyscreen/Config.in
```kconfig
config BR2_PACKAGE_GUPPYSCREEN
	bool "guppyscreen"
	depends on BR2_INSTALL_LIBSTDCPP
	depends on BR2_TOOLCHAIN_HAS_THREADS
	select BR2_PACKAGE_LIBEVDEV
	select BR2_PACKAGE_WPA_SUPPLICANT
	help
	  GuppyScreen is a native touch UI for 3D printers running
	  Klipper/Moonraker.  Rendered directly to the Linux framebuffer
	  using LVGL; talks to Moonraker over WebSocket via libhv.
	  Chosen over KlipperScreen for its lower RAM footprint.

	  Vendored submodules: lvgl, libhv, spdlog, wpa_supplicant,
	  lv_touch_calibration.

	  https://github.com/consp/guppyscreen
```

## br-external/package/klipper/Config.in
```kconfig
config BR2_PACKAGE_KLIPPER
	bool "klipper"
	select BR2_PACKAGE_PYTHON3
	select BR2_PACKAGE_PYTHON_CFFI
	select BR2_PACKAGE_PYTHON_SERIAL
	select BR2_PACKAGE_PYTHON_GREENLET
	select BR2_PACKAGE_PYTHON_NUMPY
	help
	  Klipper 3D printer host (klippy) for the FlashForge AD5M.
```

## br-external/package/klipper13/Config.in
```kconfig
config BR2_PACKAGE_KLIPPER13
	bool "klipper13 (v0.13 AD5M fork; requires matching MCU firmware)"
	select BR2_TOOLCHAIN_BARE_METAL_BUILDROOT
	select BR2_PACKAGE_PYTHON3
	select BR2_PACKAGE_PYTHON_CFFI
	select BR2_PACKAGE_PYTHON_SERIAL
	select BR2_PACKAGE_PYTHON_GREENLET
	select BR2_PACKAGE_PYTHON_NUMPY
	select BR2_PACKAGE_PYTHON_JINJA2
	select BR2_PACKAGE_PYTHON_MARKUPSAFE
	help
	  Klipper v0.13 AD5M host and both MCU firmware images as an
	  alternative to the stock-compatible v0.11.0.
	  Builds the MCU compiler and newlib from source. Installs the host to
	  /opt/klipper and MCU images to /opt/klipper/firmware. Requires matching
	  MCU firmware and a reviewed printer configuration; does not flash MCUs.
```

## br-external/package/mainsail/Config.in
```kconfig
config BR2_PACKAGE_MAINSAIL
	bool "mainsail"
	depends on BR2_HOST_GCC_AT_LEAST_8
	# Match the Python features selected by Buildroot's host-nodejs-src option.
	select BR2_PACKAGE_HOST_PYTHON3
	select BR2_PACKAGE_HOST_PYTHON3_BZIP2
	select BR2_PACKAGE_HOST_PYTHON3_SSL
	help
	  Mainsail is the popular web interface for managing and
	  controlling 3D printers with Klipper firmware. It is a
	  static web bundle built from source and installed to
	  /var/www/mainsail and served by busybox httpd. The browser connects directly
	  to the Moonraker API/WebSocket on port 7125 (no reverse
	  proxy; Moonraker cors_domains must permit the origin).

	  https://github.com/mainsail-crew/mainsail
```

## br-external/package/python-importlib-metadata/Config.in
```kconfig
config BR2_PACKAGE_PYTHON_IMPORTLIB_METADATA
	bool "python-importlib-metadata"
	select BR2_PACKAGE_PYTHON_ZIPP
	help
	  Read metadata from Python packages (backport of importlib.metadata).
	  Required by Moonraker's source_info utility.

	  https://github.com/python/importlib_metadata
```

## br-external/package/python-inotify-simple/Config.in
```kconfig
config BR2_PACKAGE_PYTHON_INOTIFY_SIMPLE
	bool "python-inotify-simple"
	help
	  A simple wrapper around inotify. No fancy bells and whistles,
	  just a literal wrapper with ctypes.

	  Used by Moonraker's file_manager component for filesystem monitoring.

	  https://github.com/chrisjbillington/inotify_simple
```

## br-external/package/python-libnacl/Config.in
```kconfig
config BR2_PACKAGE_PYTHON_LIBNACL
	bool "python-libnacl"
	select BR2_PACKAGE_LIBSODIUM
	help
	  Python bindings for libsodium based on ctypes.
	  Used by Moonraker's authorization component for API key signing.

	  https://libnacl.readthedocs.org
```

## br-external/package/python-preprocess-cancellation/Config.in
```kconfig
config BR2_PACKAGE_PYTHON_PREPROCESS_CANCELLATION
	bool "python-preprocess-cancellation"
	help
	  GCode preprocessor to add Klipper cancel-object markers.
	  Used by Moonraker's file_manager (lazy/optional import).

	  https://github.com/kageurufu/cancelobject-preprocessor
```

## br-external/package/python-smart-open/Config.in
```kconfig
config BR2_PACKAGE_PYTHON_SMART_OPEN
	bool "python-smart-open"
	select BR2_PACKAGE_PYTHON_WRAPT
	help
	  Utils for streaming large files (S3, HDFS, GCS, local files).
	  Required by python-streaming-form-data.

	  https://github.com/piskvorky/smart_open
```

## br-external/package/python-streaming-form-data/Config.in
```kconfig
config BR2_PACKAGE_PYTHON_STREAMING_FORM_DATA
	bool "python-streaming-form-data"
	select BR2_PACKAGE_PYTHON_AIOFILES
	select BR2_PACKAGE_PYTHON_SMART_OPEN
	help
	  Streaming parser for multipart/form-data (Cython C extension).
	  Required by Moonraker's application component for file uploads.

	  https://github.com/siddhantgoel/streaming-form-data
```

## br-external/package/python-zipp/Config.in
```kconfig
config BR2_PACKAGE_PYTHON_ZIPP
	bool "python-zipp"
	help
	  Backport of pathlib-compatible object wrapper for zip files.
	  Required by python-importlib-metadata.

	  https://github.com/jaraco/zipp
```

## br-external/package/reforge-zram/Config.in
```kconfig
config BR2_PACKAGE_REFORGE_ZRAM
	bool "reforge-zram"
	depends on BR2_LINUX_KERNEL
	depends on BR2_arm
	help
	  Builds zsmalloc.ko and zram.ko kernel modules from
	  the Allwinner T113 vendor BSP, vermagic 5.4.61 SMP preempt mod_unload
	  ARMv7 p2v8.  Also builds swapon_prio, a static armv7 helper that
	  calls swapon(2) with SWAP_FLAG_PREFER|priority (busybox swapon lacks
	  -p).

	  The private vendor BSP build uses the captured stock configuration,
	  independently of the main kernel's device/QEMU configuration.
	  These modules require the stock 5.4.61 kernel ABI.

	  The S35zram init script loads the modules at boot, configures the
	  compression algorithm (default: zstd) and swap device size (default:
	  256M), and activates the swap at priority 100 so zram is preferred
	  over any eMMC overflow swapfile.
```
